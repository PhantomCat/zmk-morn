## config/boards/shields/morn/Kconfig.defconfig
```kconfig
if SHIELD_MORN_LEFT

config ZMK_KEYBOARD_NAME
    default "Morn"

config ZMK_SPLIT_ROLE_CENTRAL
    default y

endif

if SHIELD_MORN_LEFT || SHIELD_MORN_RIGHT

config ZMK_SPLIT
    default y

endif
```

## config/boards/shields/morn/Kconfig.shield
```kconfig
config SHIELD_MORN_LEFT
    def_bool $(shields_list_contains,morn_left)

config SHIELD_MORN_RIGHT
    def_bool $(shields_list_contains,morn_right)
```
